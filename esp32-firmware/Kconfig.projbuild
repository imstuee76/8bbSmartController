## esp32-firmware/Kconfig.projbuild
```kconfig
menu "8bb Device Settings"

config EIGHTBB_WIFI_SSID
    string "Default Wi-Fi SSID"
    default ""

config EIGHTBB_WIFI_PASS
    string "Default Wi-Fi Password"
    default ""

config EIGHTBB_AP_SSID
    string "Fallback AP SSID"
    default "8bb-device-setup"

config EIGHTBB_AP_PASS
    string "Fallback AP Password"
    default "12345678"

config EIGHTBB_DEVICE_NAME
    string "Default device name"
    default "8bb-esp32"

config EIGHTBB_DEVICE_TYPE
    string "Default device type"
    default "relay_switch"

endmenu
```

## esp32-firmware/sdkconfig.defaults
```kconfig
CONFIG_PARTITION_TABLE_TWO_OTA=y
CONFIG_ESPTOOLPY_FLASHSIZE_4MB=y
CONFIG_ESPTOOLPY_FLASHSIZE="4MB"
CONFIG_ESP_HTTP_SERVER_ENABLE=y
CONFIG_MBEDTLS_CERTIFICATE_BUNDLE=y
```
